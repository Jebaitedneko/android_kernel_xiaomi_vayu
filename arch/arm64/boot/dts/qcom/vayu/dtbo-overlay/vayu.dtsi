/* Copyright (c) 2021, The Linux Foundation. All rights reserved.
*  Copyright (c) 2021, Jebaitedneko <Jebaitedneko@gmail.com>.
*
* This program is free software; you can redistribute it and/or modify
* it under the terms of the GNU General Public License version 2 and
* only version 2 as published by the Free Software Foundation.
*
* This program is distributed in the hope that it will be useful,
* but WITHOUT ANY WARRANTY; without even the implied warranty of
* MERCHANTABILITY or FITNESS FOR A PARTICULAR PURPOSE.  See the
* GNU General Public License for more details.
*/

/* main */

#include "include/oem/vayu-sm8150.dtsi"
#include "include/oem/vayu-audio-overlay.dtsi"
#include "vayu-audio.dtsi"
#include "vayu-pm.dtsi"
