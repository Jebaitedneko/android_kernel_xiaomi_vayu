#include "../../../sm8150-audio-overlay.dtsi"

&snd_9360 {
	status = "disabled";
};

&snd_934x {
    qcom,audio-routing =
		"AIF4 VI", "MCLK",
		"RX_BIAS", "MCLK",
		"MADINPUT", "MCLK",
		"hifi amp", "LINEOUT1",
		"hifi amp", "LINEOUT2",
		"AMIC1", "MIC BIAS1",
		"AMIC2", "MIC BIAS2",
		"MIC BIAS2", "Headset Mic",
		"AMIC3", "MIC BIAS3",
		"MIC BIAS2", "ANCRight Headset Mic",
		"AMIC4", "MIC BIAS2",
		"MIC BIAS2", "ANCLeft Headset Mic",
		"AMIC5", "MIC BIAS3",
		"MIC BIAS3", "Handset Mic",
		"DMIC0", "MIC BIAS1",
		"MIC BIAS1", "Digital Mic0",
		"DMIC1", "MIC BIAS1",
		"MIC BIAS1", "Digital Mic1",
		"DMIC2", "MIC BIAS3",
		"MIC BIAS3", "Digital Mic2",
		"DMIC3", "MIC BIAS3",
		"MIC BIAS3", "Digital Mic3",
		"DMIC4", "MIC BIAS4",
		"MIC BIAS4", "Digital Mic4",
		"DMIC5", "MIC BIAS4",
		"MIC BIAS4", "Digital Mic5",
		"SpkrLeft IN", "SPK1 OUT",
		"SpkrRight IN", "SPK2 OUT";

    qcom,msm-mbhc-hphl-swh = <0>;
	qcom,msm-mbhc-gnd-swh = <0>;

    qcom,wsa-max-devs = <0>;

	pinctrl-names = "quat_mi2s_enable", "quat_mi2s_disable",
			"quat_tdm_enable", "quat_tdm_disable";
	pinctrl-0 = <&quat_mi2s_active &quat_mi2s_sd0_active
					&quat_mi2s_sd1_active>;
	pinctrl-1 = <&quat_mi2s_sleep &quat_mi2s_sd0_sleep
					&quat_mi2s_sd1_sleep>;
	pinctrl-2 = <&quat_tdm_active &quat_tdm_dout_active>;
	pinctrl-3 = <&quat_tdm_sleep &quat_tdm_dout_sleep>;
};

&wcd934x_cdc {
    qcom,cdc-micbias1-mv = <2700>;
	qcom,cdc-micbias3-mv = <2700>;
	qcom,cdc-micbias4-mv = <2700>;
};
