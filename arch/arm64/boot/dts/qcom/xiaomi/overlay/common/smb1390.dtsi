&qupv3_se4_i2c {
	#include "../../../smb1390.dtsi"
};

&smb1390_slave {
	interrupt-parent = <&spmi_bus>;
	interrupts = <0x2 0xC5 0x0 IRQ_TYPE_LEVEL_LOW>;
	interrupt_names = "smb1390_slave";
	interrupt-controller;
	#interrupt-cells = <3>;
};

&smb1390_slave_charger {
	interrupt-parent = <&smb1390_slave>;
};
